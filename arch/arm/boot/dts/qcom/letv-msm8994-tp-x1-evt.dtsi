/* Copyright (C) 2014 Synaptics Incorporated
 *
 * Copyright (C) 2014 Alexandra Chin <alexandra.chin@tw.synaptics.com>
 * Copyright (C) 2014 Scott Lin <scott.lin@tw.synaptics.com>
 *
 * This program is free software; you can redistribute it and/or modify
 * it under the terms of the GNU General Public License as published by
 * the Free Software Foundation; either version 2 of the License, or
 * (at your option) any later version.
 *
 * This program is distributed in the hope that it will be useful,
 * but WITHOUT ANY WARRANTY; without even the implied warranty of
 * MERCHANTABILITY or FITNESS FOR A PARTICULAR PURPOSE. See the
 * GNU General Public License for more details.
 */

&soc {
	i2c@f9924000 {
		synaptics_dsx@4b {
			compatible = "synaptics,dsx";
			reg = <0x4b>;
			interrupt-parent = <&msm_gpio>;
			interrupts = <61 0x2>;
			vdd_ana-supply = <&pm8994_l22>;
			synaptics,pwr-reg-name = "vdd_ana";
			pinctrl-names = "pmx_ts_active", "pmx_ts_suspend";
			pinctrl-0 = <&ts_2_active>;
			pinctrl-1 = <&ts_2_suspend>;
			synaptics,reset-gpio = <&msm_gpio 63 0x00>;
			synaptics,reset-on-state = <0>;
			synaptics,reset-active-ms = <0x08>;
			synaptics,irq-gpio = <&msm_gpio 61 0x00>;
			synaptics,irq-on-state = <0>;
			synaptics,irq-flags = <0x2002>; /* IRQF_ONESHOT | IRQF_TRIGGER_FALLING */
			synaptics,power-delay-ms = <100>;
			synaptics,cap-button-codes = <139 172 158>;
			synaptics,reset-delay-ms = <80>;
			synaptics,max-y-for-2d = <2560>; /* remove if no virtual buttons */
			synaptics,vir-button-codes = <102 100 900 100 60 158 300 900 100 60>;
		};
	};
};
